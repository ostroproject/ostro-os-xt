## meta-ostro-xt/conf/distro/include/ostro-xt-security-flags.inc
```bitbake
# NOTE: SECURITY_NO_PIE_CFLAGS and SECURITY_PIC_CFLAGS are defined in
#       meta-ostro/conf/distro/include/ostro_security_flags.inc
SECURITY_CFLAGS_pn-log4cxx = "${SECURITY_NO_PIE_CFLAGS} ${SECURITY_PIC_CFLAGS}"
SECURITY_CFLAGS_pn-cppunit = "${SECURITY_NO_PIE_CFLAGS} ${SECURITY_PIC_CFLAGS}"
SECURITY_CFLAGS_pn-sphinxbase = "${SECURITY_NO_PIE_CFLAGS} ${SECURITY_PIC_CFLAGS}"
SECURITY_CFLAGS_pn-python-lxml = "${SECURITY_NO_PIE_CFLAGS} ${SECURITY_PIC_CFLAGS}"
SECURITY_CFLAGS_pn-pocketsphinx = "${SECURITY_NO_PIE_CFLAGS} ${SECURITY_PIC_CFLAGS}"
SECURITY_CFLAGS_pn-tbb = "${SECURITY_NO_PIE_CFLAGS} ${SECURITY_PIC_CFLAGS}"
SECURITY_CFLAGS_pn-yaml-cpp = "${SECURITY_NO_PIE_CFLAGS} ${SECURITY_PIC_CFLAGS}"
SECURITY_CFLAGS_pn-python-netifaces = "${SECURITY_NO_PIE_CFLAGS} ${SECURITY_PIC_CFLAGS}"
SECURITY_CFLAGS_pn-protobuf = "${SECURITY_NO_PIE_CFLAGS} ${SECURITY_PIC_CFLAGS}"
SECURITY_CFLAGS_pn-wxwidgets = "${SECURITY_NO_PIE_CFLAGS} ${SECURITY_PIC_CFLAGS}"
SECURITY_CFLAGS_pn-clang = "${SECURITY_NO_PIE_CFLAGS} ${SECURITY_PIC_CFLAGS}"
SECURITY_CFLAGS_pn-python-pyyaml = "${SECURITY_NO_PIE_CFLAGS} ${SECURITY_PIC_CFLAGS}"

SECURITY_STRINGFORMAT_pn-qhull = ""
SECURITY_STRINGFORMAT_pn-libgphoto2 = ""
SECURITY_STRINGFORMAT_pn-wxpython = ""

# Those are outdated packages, we'll need to update them anyway and don't
# care about the fact they use host's compiler.
SECURITY_CFLAGS_remove_pn-mozjs = "-fstack-protector-strong"
SECURITY_CFLAGS_append_pn-mozjs = " -fstack-protector-all"
SECURITY_LDFLAGS_remove_pn-mozjs = "-fstack-protector-strong"
SECURITY_LDFLAGS_append_pn-mozjs = " -fstack-protector-all"

SECURITY_CFLAGS_remove_pn-libatasmart = "-fstack-protector-strong"
SECURITY_CFLAGS_append_pn-libatasmart = " -fstack-protector-all"
SECURITY_LDFLAGS_remove_pn-libatasmart = "-fstack-protector-strong"
SECURITY_LDFLAGS_append_pn-libatasmart = " -fstack-protector-all"
```

## meta-ostro-xt/conf/distro/include/ostroproject-ci.inc
```bitbake
#
# https://ostroproject.org/jenkins CI configuration:
# This file applied via conf/auto.conf for every build
# happening in Ostro Project CI
#

#
# Static section
# Items that are always present in any CI build:
#

# Generate summary statistics
INHERIT += "buildstats-summary"

# Enable CVE and other secutiry checks
INHERIT += "isafw"

# Enable extended buildhistory:
INHERIT += "buildhistory"
BUILDHISTORY_COMMIT = "1"
INHERIT += "buildhistory-extra"

# Test data generation:
INHERIT += "test-iot"
TEST_EXPORT_DIR = "iottest"
TEST_TARGET = "simpleremote"

# SDK defaults:
SDKMACHINE ?= "x86_64"

# Generate source mirror tarballs:
BB_GENERATE_MIRROR_TARBALLS = "1"

# Configure images in "development mode".
require conf/distro/include/ostro-os-development.inc

OSTRO_VM_IMAGE_TYPES = "dsk.xz dsk.ova dsk.bmap dsk.xz.sha256sum"

# Automated build targets
# These targets must be space-separated lists of items.
# Valid symbols are: alphanumeric ones,'-' and '_'.
# The parser will skip everything else.
#
# Target(s) for the default build:
OSTROPROJECT_CI_BUILD_TARGETS=" \
  ostro-xt-image-noswupd \
  ostro-xt-image-noswupd-benchmark-qa \
  ostro-xt-image-swupd \
"

# Following targets will be executed with do_populate_sdk
# resp. do_populate_sdk_ext task. In Ostro OS XT, all images
# full-featured, so it does not matter whether we pick swupd
# or noswupd here.
OSTROPROJECT_CI_SDK_TARGETS="ostro-xt-image-noswupd"
OSTROPROJECT_CI_ESDK_TARGETS="${OSTROPROJECT_CI_SDK_TARGETS}"

# Including debug packages increases the size of the
# ostroxt-x86_64-corei7-64-toolchain-1.0+snapshot.sh by more than 2x.
# Therefore we don't use them.
SDKIMAGE_FEATURES_remove = "dbg-pkgs"

# Target(s) for the task "do_test_iot_export":
OSTROPROJECT_CI_TEST_EXPORT_TARGETS="ostro-xt-image-swupd"

# Automatic tests. Entries are separated by spaces.
# Each entry is a tuple, in the format:
# <image_name>,<testsuite_name>,<testfiles_name>,$MACHINE

OSTROPROJECT_CI_TEST_RUNS=" \
  ostro-xt-image-swupd,iot-testsuite.tar.gz,iot-testfiles.${MACHINE}.tar.gz,${MACHINE} \
"

# In the CI system, the integer OS version used for swupd is
# derived from the Jenkins build number part of the BUILD_ID.
# The conversion to int and back to string acts as sanity
# check that we really get a number out of the BUILD_ID.

#
# BUILD_ID is expected to have this format:
# BUILD_ID = "<parent-build-timestamp (of Jenkins top job)>" + "-build-" + "<jenkins-top-job-build-number>"
#
# We multiply it by ten, to ensure that the version space has
# some gap for minor updates. How to actually build minor updates
# with Jenkins still needs to be determined.
OS_VERSION ?= "${@ str(int('${BUILD_ID}'.split('-')[-1]) * 10) }"

#
# Dymamic section.
# The values are applied dynamically based either on runtime config or on
# builder host parameters. It is present exclusively as reference.
#

# Explicit machine declaration by build job:
# MACHINE = "$TARGET_MACHINE"

# Shared download directory between builders:
# DL_DIR = "/srv/bb-cache/ostro-os/sources"

# Limit CPU utilization, based on amount of slots/CPU cores
# on builder hosts:
# BB_NUMBER_PARSE_THREADS = "X"
# BB_NUMBER_THREADS = "X"
# PARALLEL_MAKE = "-j X"

# Local optimizations on SSTATE directories, shared between builder hosts:
# SSTATE_MIRRORS ?= "file://.* http://$IP/bb-cache/ostro-os/sstate/PATH"
# SSTATE_DIR ?= "/var/tmp/sstate-$slot"

# Local directory, where builder puts local copy of buildhistory
# BUILDHISTORY_DIR ?="$WORKSPACE/buildhistory"

# PRserv host dynamically allocated by master:
# PRSERV_HOST = "$IP:$PORT"

# Enabled for master release builds:
# INHERIT += "archiver"
# ARCHIVER_MODE[src] = "original"
# ARCHIVER_MODE[diff] = "1"
# ARCHIVER_MODE[recipe] = "1"
```

## meta-ostro-xt/conf/distro/ostro-xt.conf
```bitbake
require conf/distro/ostro.conf
require conf/distro/include/ostro-xt-security-flags.inc

DISTRO = "ostro-xt"
DISTRO_NAME = "Ostro OS XT"
DISTRO_FEATURES += " \
    x11 \
    opengl \
"

# disable IMA
DISTRO_FEATURES_remove = "ima"

SDK_VENDOR = "-ostroxtsdk"
SDK_NAME_PREFIX = "ostroxt"
SDK_UPDATE_URL = "${OSTRO_XT_SDK_UPDATE_URL}"

# SDK_UPDATE_URL defines the eSDK updateserver configured in
# devtool.conf when populate-sdk-ext is run.
#
# The default setting can be overridden in local.conf
OSTRO_XT_SDK_UPDATE_URL ??= "https://download.ostroproject.org/builds/ostro-os-xt/latest/sdk-data/${MACHINE}"

# Disable support for clang since meta-clang isn't really production ready
RDEPENDS_packagegroup-core-standalone-sdk-target_remove = "compiler-rt-dev"
RDEPENDS_packagegroup-core-standalone-sdk-target_remove = "compiler-rt-staticdev"
RDEPENDS_packagegroup-core-standalone-sdk-target_remove = "libcxx-dev"
RDEPENDS_packagegroup-core-standalone-sdk-target_remove = "libcxxabi-dev"
RDEPENDS_packagegroup-core-standalone-sdk-target_remove = "llvm-libunwind-dev"

# Fix CMake needed by clang
SSTATE_SCAN_FILES_append = " *.cmake"

# Tweak packages added by ROS
PREFERRED_VERSION_cv-bridge ?= "1.99.%"
PREFERRED_VERSION_image-geometry ?= "1.99.%"

PREFERRED_PROVIDER_virtual/opencl-headers ?= "beignet"
PREFERRED_PROVIDER_virtual/opencl-headers-cxx ?= "beignet"

# By default .la files are not removed from Yocto distros
INHERIT += "remove-libtool"

# Ostro OS XT adds some additional users and groups for which
# we need static IDs.
USERADD_UID_TABLES += "conf/distro/include/ostro-xt-passwd"
USERADD_GID_TABLES += "conf/distro/include/ostro-xt-group"

SUPPORTED_RECIPES_append = " ${META_OSTRO_XT_BASE}/conf/distro/include/ostro-xt-supported-recipes.txt"
MACHINE_ESSENTIAL_EXTRA_RDEPENDS_remove_intel-corei7-64 = " \
    spi-minnowmax-board \
    i2c-minnowmax-board \
"

# Settings for current BXT platforms. Normally this would go into a
# machine configuration, but Ostro OS XT only targets BXT, so this is
# okayish here.
APPEND += " console=ttyS2,115200 video=efifb maxcpus=4 noxsave reboot=efi kmemleak=off"
SERIAL_CONSOLE = "115200 ttyS2"
# We get console=ttyS0,115200 from meta-intel/conf/machine/intel-corei7-64.conf and
# need to get rid of it.
APPEND_remove = "console=ttyS0,115200"

# Mixing X11 startup from meta-oe (xserver-common) and OE-core
# (x11-common) fails (they conflict). xserver-nodm-init from meta-oe
# brings in xserver-common, so we stick to the one from OE-core.
BBMASK += "/meta-oe/recipes-graphics/xserver-nodm-init/"

# We need swig from OE-core, not meta-intel-iot-middleware
BBMASK += "/meta-intel-iot-middleware/recipes-devtools/swig/"

# Blacklisted in meta-oe because it fails to compile with gcc 6.
# But we can use it because we are still on gcc 5.x.
PNBLACKLIST[opencv] = ""
PNBLACKLIST[glmark2] = ""

# When undoing the opencv blacklisting, the older
# 2.x version also gets un-blacklisted although
# it isn't compatible with current ffmpeg, and
# because of DEFAULT_PREFERENCE = "-1" in the 3.1.bb
# we end up picking the 2.x version unless
# we explicitly request 3.x.
PREFERRED_VERSION_opencv = "3.%"

# Some recipes (like fwts) started to use compile
# flags that only work with gcc 6. Need to
# remove them.
CFLAGS_remove = "-Wno-error=misleading-indentation"
CXXFLAGS_remove = "-Wno-error=misleading-indentation"
```

## meta-ostro-xt/conf/layer.conf
```bitbake
# We have a conf directory, add to BBPATH.
BBPATH =. "${LAYERDIR}:"

## Add our modified ros class to path
BBPATH .= ":${LAYERDIR}/recipes-ros"

# We have recipes-* directories, add to BBFILES
BBFILES += "${LAYERDIR}/recipes-*/*/*.bb \
	${LAYERDIR}/recipes-*/*/*.bbappend \
"

BBFILE_COLLECTIONS += "ostro-xt"
BBFILE_PATTERN_ostro-xt := "^${LAYERDIR}/"
BBFILE_PRIORITY_ostro-xt = "10"

# meta-ostro-xt/conf/*.sample files were copied from ostro-os/meta-ostro/conf.
# When Ostro OS changes those files, meta-ostro-xt needs to be updated
# accordingly:
# - merge the new upstream changes into the copied files (three-way merge)
# - bump the EXPECTED_OSTRO_OS_LOCALCONF/LAYER_CONF_VERSION version numbers here
#
# The Python code in the variable assignments below checks for that.
#
# When making additional changes to the copied files that are specific
# to Ostro OS XT, just bump OSTRO_OS_XT_LOCALCONF/LAYER_CONF_VERSION.
EXPECTED_OSTRO_OS_LOCALCONF_VERSION = "4"
EXPECTED_OSTRO_OS_LAYER_CONF_VERSION = "9"
OSTRO_OS_XT_LOCALCONF_VERSION = "1"
OSTRO_OS_XT_LAYER_CONF_VERSION = "3"

LOCALCONF_VERSION = "${@ str(int(${OSTRO_OS_LOCALCONF_VERSION}) * 100 + int(${OSTRO_OS_XT_LOCALCONF_VERSION})) if ${EXPECTED_OSTRO_OS_LOCALCONF_VERSION} == ${OSTRO_OS_LOCALCONF_VERSION} else bb.fatal('OSTRO_OS_LOCALCONF_VERSION = ${OSTRO_OS_LOCALCONF_VERSION} does not match EXPECTED_OSTRO_OS_LOCALCONF_VERSION = ${EXPECTED_OSTRO_OS_LOCALCONF_VERSION}, meta-ostro-xt needs to be updated (see ${META_OSTRO_XT_BASE}/conf/layer.conf)') }"
LAYER_CONF_VERSION = "${@ str(int(${OSTRO_OS_LAYER_CONF_VERSION}) * 100 + int(${OSTRO_OS_XT_LAYER_CONF_VERSION})) if ${EXPECTED_OSTRO_OS_LAYER_CONF_VERSION} == ${OSTRO_OS_LAYER_CONF_VERSION} else bb.fatal('OSTRO_OS_LAYER_CONF_VERSION = ${OSTRO_OS_LAYER_CONF_VERSION} does not match EXPECTED_OSTRO_OS_LAYER_CONF_VERSION = ${EXPECTED_OSTRO_OS_LAYER_CONF_VERSION}, meta-ostro-xt needs to be updated (see ${META_OSTRO_XT_BASE}/conf/layer.conf)') }"

# Point in error messages to the right files in meta-ostro-xt.
SANITY_LOCALCONF_SAMPLE = "${META_OSTRO_XT_BASE}/conf/local.conf.sample"
SANITY_BBLAYERCONF_SAMPLE = "${META_OSTRO_XT_BASE}/conf/bblayers.conf.sample"

# Set a variable to get to the top of the Ostro OS XT metadata location.
META_OSTRO_XT_BASE := '${LAYERDIR}'
```
